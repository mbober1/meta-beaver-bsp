## conf/machine/rock-5b-plus.conf
```bitbake
#@TYPE: Machine
#@NAME: Radxa Rock 5B+
#@DESCRIPTION: ROCK5+ is the 5th generation of SBC designed by Radxa.
#https://radxa.com/products/rock5/5bp

require conf/machine/include/rk3588.inc
require conf/machine/include/ota-ab.inc

IMAGE_FSTYPES = "wic wic.zst tar.zst"


KERNEL_DEVICETREE ?= "rockchip/rk3588-rock-5b-plus.dtb"
MACHINE_EXTRA_RRECOMMENDS += "kernel-modules"
PREFERRED_PROVIDER_virtual/kernel = "linux-torvalds"

UBOOT_MACHINE = "rock5b-rk3588_defconfig"
UBOOT_EXTLINUX_KERNEL_ARGS += "rootwait rw rootfstype=ext4"

PARTITION_TABLE_FAMILY = "rockchip"
```
