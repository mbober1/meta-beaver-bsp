## conf/machine/include/ota-ab.inc
```bitbake
OTA_ROOTFS_SIZE ?= "3072"
OTA_DATA_SIZE ?= "128"
OTA_SWAP_SIZE ?= "512"

OVERLAYFS_MOUNT_POINT[data] ?= "/data"
OVERLAYFS_QA_SKIP[data] = "mount-configured"

# Discoverable Partitions Specification (DPS)
ROOT_DPS:arm = "69dad710-2ce4-4e3c-b16c-21a1d49abed3"
ROOT_DPS:aarch64 = "b921b045-1df0-41c3-af44-4c6f280d3fae"
SWAP_DPS = "0657fd6d-a4ab-43c4-84e5-0933c84b4f4f"
```

## conf/machine/include/rk3506.inc
```bitbake
MACHINEOVERRIDES =. "rk3506:"
SOC_FAMILY = "rk3506"
DEFAULTTUNE = "cortexa7thf-neon-vfpv4"

ROCKCHIP_CLOSED_TPL ?= "1"
RK_KERNEL_FITIMAGE = "False"

require conf/machine/include/soc-family.inc
require conf/machine/include/rockchip-defaults.inc
require conf/machine/include/arm/armv7a/tune-cortexa7.inc
require conf/machine/include/rockchip-wic.inc

KBUILD_DEFCONFIG ?= "rk3506_defconfig"

UBOOT_SUFFIX ?= "itb"
UBOOT_ENTRYPOINT ?= "0x02800000"
```

## conf/machine/include/stm32mp1.inc
```bitbake
require conf/machine/include/soc-family.inc
include conf/machine/include/arm/armv7a/tune-cortexa7.inc

DEFAULTTUNE = "cortexa7thf-neon-vfpv4"

SOC_FAMILY = "stm32mp1"

PREFERRED_PROVIDER_virtual/kernel ??= "linux-yocto"

UBOOT_SUFFIX = "img"
UBOOT_ENTRYPOINT = "0xC2000040"

SERIAL_CONSOLES = "115200;ttySTM0"
SERIAL_CONSOLES_CHECK = "${SERIAL_CONSOLES}"


IMAGE_FSTYPES = "wic wic.zst tar.zst"

WKS_FILE_DEPENDS ?= " \
    virtual/bootloader \
    e2fsprogs-native \
"
```

## conf/machine/luckfox-lyra-plus.conf
```bitbake
#@TYPE: Machine
#@NAME: Luckfox Lyra Plus
#@DESCRIPTION: RK3506G2 based Linux Micro Development Board
#https://www.luckfox.com/Luckfox-Lyra-Plus

require conf/machine/include/rk3506.inc
require conf/machine/include/ota-ab.inc

IMAGE_FSTYPES = "wic wic.zst tar.zst"


KERNEL_DEVICETREE ?= "rockchip/rk3506g-luckfox-lyra-plus-sd.dtb"
MACHINE_EXTRA_RRECOMMENDS += "kernel-modules"
PREFERRED_PROVIDER_virtual/kernel = "linux-torvalds"

SERIAL_CONSOLES = "1500000;ttyS0"
UBOOT_MACHINE = "luckfox-lyra-rk3506_defconfig"
UBOOT_EXTLINUX_ROOT = "root=/dev/mmcblk0p${bootpart}"

KERNEL_FEATURES += " \
  cfg/fs/ext4.scc \
  features/cgroups/cgroups.scc \
"

OTA_ROOTFS_SIZE = "1024"
WKS_FILE = "${@bb.utils.contains('MACHINE_FEATURES', 'ota', 'ota_partitions.wks.in', 'mini_partitions.wks.in', d)}"
```

## conf/machine/luckfox-lyra.conf
```bitbake
#@TYPE: Machine
#@NAME: Luckfox Lyra Plus
#@DESCRIPTION: RK3506G2 based Linux Micro Development Board
#https://www.luckfox.com/Luckfox-Lyra-Plus

require conf/machine/include/rk3506.inc

IMAGE_FSTYPES = "wic wic.zst tar.zst"


KERNEL_DEVICETREE ?= "rk3506g-luckfox-lyra-plus-sd.dtb"
MACHINE_EXTRA_RRECOMMENDS += "kernel-modules"
PREFERRED_PROVIDER_virtual/kernel = "linux-armbian"
EXTERNAL_KERNEL_DEVICETREE = "${DEPLOY_DIR_IMAGE}/devicetree"
KERNEL_DTC_FLAGS += "-@"


UBOOT_MACHINE = "luckfox-lyra-rk3506_defconfig"
UBOOT_EXTLINUX_ROOT = "root=/dev/mmcblk0p3"

WKS_FILE = "mini_partitions.wks.in"

MACHINE_FEATURES = " \
  rtc \
  screen \
  serial \
  usbgadget \
  usbhost \
  vfat \
"

KERNEL_FEATURES += " \
  cfg/fs/ext4.scc \
  features/cgroups/cgroups.scc \
"
```

## conf/machine/rock-5b-plus.conf
```bitbake
#@TYPE: Machine
#@NAME: Radxa Rock 5B+
#@DESCRIPTION: ROCK5+ is the 5th generation of SBC designed by Radxa.
#https://radxa.com/products/rock5/5bp

require conf/machine/include/rk3588.inc
require conf/machine/include/ota-ab.inc

IMAGE_FSTYPES = "wic wic.zst tar.zst"


KERNEL_DEVICETREE ?= "rockchip/rk3588-rock-5b-plus.dtb"
MACHINE_EXTRA_RRECOMMENDS += "kernel-modules"
PREFERRED_PROVIDER_virtual/kernel = "linux-torvalds"

UBOOT_MACHINE = "rock5b-rk3588_defconfig"
UBOOT_EXTLINUX_KERNEL_ARGS += "rootwait rw rootfstype=ext4"
UBOOT_EXTLINUX_ROOT = "${@bb.utils.contains('MACHINE_FEATURES', 'nvme_boot', 'root=/dev/nvme0n1p''$''{bootpart}', 'root=/dev/mmcblk0p''$''{bootpart}', d)}"


WKS_FILE = "${@bb.utils.contains('MACHINE_FEATURES', 'ota', 'ota_partitions.wks.in', 'mini_partitions.wks.in', d)}"
```

## conf/machine/stm32mp15-disco.conf
```bitbake
#@TYPE: Machine
#@NAME: STM32MP157D-DK1
#@MAINTAINER: Marcin Bober <mbober1@gmail.com>

require conf/machine/include/stm32mp1.inc

KERNEL_DEVICETREE ?= "st/stm32mp157c-dk2.dtb"
KBUILD_DEFCONFIG ?= "multi_v7_defconfig"
KCONFIG_MODE = "--alldefconfig"

SPL_BINARY ?= "u-boot-spl.stm32"
UBOOT_MACHINE ?= "stm32mp15_basic_defconfig"
UBOOT_EXTLINUX ?= "1"
UBOOT_EXTLINUX_KERNEL_ARGS ?= "rootwait rw rootfstype=ext4"
UBOOT_EXTLINUX_ROOT ?= "root=/dev/mmcblk0p${bootpart}"
UBOOT_EXTLINUX_CONSOLE ?= "${SERIAL_CONSOLES}"
UBOOT_EXTLINUX_FDT ?= "../stm32mp157c-dk2.dtb"

# PREFERRED_PROVIDER_virtual/kernel ?= "linux-yocto"
PREFERRED_PROVIDER_virtual/kernel = "linux-torvalds"
INSANE_SKIP:linux-torvalds-src += "buildpaths"

MACHINE_ESSENTIAL_EXTRA_RDEPENDS += " \
    kernel-image \
    kernel-devicetree \
    kernel-modules \
    u-boot \
    linux-yocto-fitimage \
"

KERNEL_CLASSES += "kernel-fit-extra-artifacts"
KERNEL_IMAGETYPE ?= "Image"
RRECOMMENDS:${KERNEL_PACKAGE_NAME}-base = ""
KERNEL_DEPLOY_DEPEND ?= "linux-yocto-fitimage:do_deploy"

WKS_FILE = "stm32mp157-basic-ota.wks.in"
```
